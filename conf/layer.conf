## conf/layer.conf
```bitbake
BBPATH .= ":${LAYERDIR}"

BBFILES += " \
    ${LAYERDIR}/recipes-*/*/*.bb \
    ${LAYERDIR}/recipes-*/*/*.bbappend \
"

BBFILE_COLLECTIONS += "meta-dualsense"
BBFILE_PATTERN_meta-dualsense = "^${LAYERDIR}/"
BBFILE_PRIORITY_meta-dualsense = "10"

LAYERVERSION_meta-dualsense = "1"
LAYERSERIES_COMPAT_meta-dualsense = "scarthgap"
LAYERDEPENDS_meta-dualsense = "core openembedded-layer meta-arm meta-ti-bsp"
```
